## examples/esp_idf/basic/sdkconfig.defaults
```kconfig
CONFIG_ETH_USE_ESP32_EMAC=y
CONFIG_FREERTOS_HZ=1000
CONFIG_ESP_MAIN_TASK_STACK_SIZE=16384
# CONFIG_DP8382X_BOARD_READY is not set
```

## examples/esp_idf/owner/main/Kconfig.projbuild
```kconfig
menu "DP8382x P4 example"
    config DP8382X_BOARD_READY
        bool "Allow this confirmed and powered board to run Ethernet"
        default n
        help
            Enable only after checking the final netlist, supplying PHY 3V3,
            confirming PHY address 0, 25 MHz oscillator, 50 MHz RMII clock,
            reset waveform and all required power rails on the actual board.
            The default image only reports its configuration and does not
            touch MAC, MDIO, reset GPIO or the network.
    config DP8382X_ENABLE_TEST_FRAME
        bool "Allow explicit single experimental Ethernet frame on x"
        depends on DP8382X_BOARD_READY
        default n
        help
            On a dedicated test segment, x queues one 60-byte Ethernet frame
            for the active session. The destination is 02:00:00:00:00:2A and
            EtherType is 0x88B5. There is no periodic or automatic transmission.
endmenu
```

## examples/esp_idf/owner/sdkconfig.defaults
```kconfig
CONFIG_ETH_USE_ESP32_EMAC=y
CONFIG_FREERTOS_HZ=1000
# CONFIG_DP8382X_BOARD_READY is not set
# CONFIG_DP8382X_ENABLE_TEST_FRAME is not set
# CONFIG_ETH_TRANSMIT_MUTEX is not set
# CONFIG_ESP_MM_CACHE_MSYNC_C2M_CHUNKED_OPS is not set
CONFIG_ESP_MAIN_TASK_STACK_SIZE=16384
CONFIG_ESP_CONSOLE_UART_DEFAULT=y
CONFIG_ESP_CONSOLE_SECONDARY_NONE=y
CONFIG_ESP_CONSOLE_UART_BAUDRATE=115200
CONFIG_LOG_VERSION_1=y
```
